## benchmark/native/freertos_esp32/sdkconfig.defaults
```kconfig
CONFIG_ESP_DEFAULT_CPU_FREQ_MHZ_240=y
CONFIG_FREERTOS_UNICORE=y
CONFIG_FREERTOS_HZ=100
CONFIG_FREERTOS_TIMER_TASK_PRIORITY=12
CONFIG_FREERTOS_TIMER_QUEUE_LENGTH=20
CONFIG_ESP_MAIN_TASK_STACK_SIZE=4096
CONFIG_ESPTOOLPY_FLASHSIZE_4MB=y
CONFIG_COMPILER_OPTIMIZATION_PERF=y
CONFIG_LOG_DEFAULT_LEVEL_WARN=y
CONFIG_BOOTLOADER_LOG_LEVEL_WARN=y
```

## benchmark/native/freertos_idf_linux/sdkconfig.defaults
```kconfig
CONFIG_IDF_TARGET="linux"
CONFIG_FREERTOS_HZ=1000
CONFIG_FREERTOS_TIMER_TASK_PRIORITY=10
CONFIG_FREERTOS_TIMER_QUEUE_LENGTH=20
CONFIG_FREERTOS_TIMER_TASK_STACK_DEPTH=32768
CONFIG_ESP_MAIN_TASK_STACK_SIZE=32768
```
